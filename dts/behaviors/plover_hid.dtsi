/ {
    behaviors {
        /omit-if-no-ref/ plv: plover_hid {
            compatible = "zmk,behavior-plover-hid";
            display-name = "Plover HID";
            #binding-cells = <2>;
        };
    };
};
